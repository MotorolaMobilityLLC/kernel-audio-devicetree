#include "pitti-audio-overlay.dtsi"

&wcd9378_rst_gpio {
	compatible = "qcom,msm-cdc-pinctrl";
	pinctrl-names = "aud_active", "aud_sleep";
	pinctrl-0 = <&wcd9378_2_reset_active>;
	pinctrl-1 = <&wcd9378_2_reset_sleep>;
};

&wcd9378_codec {
	qcom,wcd-rst-gpio-node = <&wcd9378_rst_gpio>;
};

&pitti_snd {
	qcom,model = "pitti-qrd-snd-card";
};
