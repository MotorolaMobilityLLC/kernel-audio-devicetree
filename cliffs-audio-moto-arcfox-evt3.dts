/dts-v1/;
/plugin/;

#include "cliffs-audio-moto-arcfox-common.dtsi"
 / {
	model = "Qualcomm Technologies, Inc. Cliffs MTP";
	compatible = "qcom,cliffs-mtp", "qcom,cliffs", "qcom,mtp";
	qcom,msm-id = <614 0x10000>;
	qcom,board-id = <0x43 0xA300>, <0x43 0xB1B0>, <0x43 0xB1C0>;
};
