#include "volcano-audio-cdp-wcd9395.dtsi"
#include "volcano-audio-bt-swr.dtsi"

&pineapple_snd {
	/delete-property/ qcom,pri-mi2s-gpios;
	qcom,model = "volcano6-cdp-wsa883x_wcd939x-snd-card";
	qcom,wcn-bt = <0>;
	qcom,wcn-btfm-proxy = <1>;
};

&fm_i2s0_gpios {
	status = "disabled";
};
