// SPDX-License-Identifier: BSD-3-Clause
/*
 * Copyright (c) 2023-2024 Qualcomm Innovation Center, Inc. All rights reserved.
 */

/dts-v1/;
/plugin/;

#include "canoe-audio-moto-blanc-common.dtsi"
 / {
	model = "blanc";
	compatible = "qcom,canoe-qrd", "qcom,canoe", "qcom,qrd";
	qcom,msm-id = <660 0x10000>, <660 0x20000>, <661 0x10000>, <661 0x20000>,
		      <0x1000294 0x10000>, <0x1000294 0x20000>,
		      <0x1000295 0x10000>, <0x1000295 0x20000>;
	qcom,board-id = <0x41 0x9100>;
};

/* the i2c pins is used by camera pin on evb board, can't be enabled */
&qupv3_se23_i2c {
    status = "disabled";
};
