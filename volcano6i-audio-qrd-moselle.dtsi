#include "volcano-audio-qrd.dtsi"

&pineapple_snd {
	qcom,model = "volcano6i-qrd-wsa883x-snd-card";
	/delete-property/ qcom,pri-mi2s-gpios;
	qcom,wcn-bt = <0>;
};

&fm_i2s0_gpios {
	status = "disabled";
};
