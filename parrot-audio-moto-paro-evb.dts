/dts-v1/;
/plugin/;

#include "parrot-cuso-audio-overlay.dtsi"
/{
	model = "paro";
	compatible = "qcom,parrot-qrd", "qcom,parrot", "qcom,qrd", "moto,paro";
	qcom,msm-id = <537 0x10000>;
	qcom,board-id = <0x43 0x9000>;
};

