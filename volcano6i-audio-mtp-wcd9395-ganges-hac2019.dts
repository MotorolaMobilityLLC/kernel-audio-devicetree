/dts-v1/;
/plugin/;

#include "volcano6i-audio-mtp-wcd9395-ganges-hac2019.dtsi"

/ {
	model = "Qualcomm Technologies, Inc. Volcano6I MTP + WCD9395 HSJ + HAC2019/RFID + Ganges";
	compatible = "qcom,volcano-mtp", "qcom,volcano", "qcom,volcanop-mtp", "qcom,volcanop", "qcom,mtp";
	qcom,msm-id = <0x4000291 0x10000>, <0x8000291 0x10000>,
		      <0xc000291 0x10000>, <0x10000291 0x10000>,
		      <0x4000292 0x10000>, <0x8000292 0x10000>,
		      <0xc000292 0x10000>, <0x10000292 0x10000>;
	qcom,board-id = <8 4>;
};
