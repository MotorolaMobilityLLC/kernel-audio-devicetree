/dts-v1/;
/plugin/;

#include "khaje-audio-moto-rhode-common.dtsi"
/ {
	model = "rhode";
	compatible = "qcom,khaje-idp", "qcom,khaje", "qcom,idp", "mot,rhode";
	qcom,msm-id = <518 0x10000>, <586 0x10000>;
	qcom,board-id = <0x41 0xA000>;
	qcom,pmic-id = <0x2D 0x0 0x0 0x0>;
};
