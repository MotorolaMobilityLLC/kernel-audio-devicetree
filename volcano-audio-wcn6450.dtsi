#include "volcano-audio-bt-swr.dtsi"

&pineapple_snd {
	qcom,model = "volcano-mtp-wsa883x_wcn6450-snd-card";
	qcom,sku-model = "volcano-mtp-wsa883x_wcn6450_sku1-snd-card";
	nvmem-cells = <&adsp_variant>;
	nvmem-cell-names = "adsp_variant";
	qcom,msm_audio_ssr_devs = <&audio_gpr>, <&lpi_tlmm>,
		<&lpass_cdc>,  <&lpass_bt_swr>;
	qcom,wcn-bt = <0>;
	qcom,wcn-btfm-proxy = <1>;
};

&fm_i2s0_gpios {
	status = "disabled";
};
