// SPDX-License-Identifier: BSD-3-Clause
/*
 * Copyright (c) 2023 Qualcomm Innovation Center, Inc. All rights reserved.
 */
// This file is copied from:sun-audio-moto-leap-evb.dts
/dts-v1/;
/plugin/;

#include "sun-audio-moto-leap-common.dtsi"
 / {
	model = "Qualcomm Technologies, Inc. Sun QRD";
	compatible = "qcom,sun-qrd", "qcom,sun", "qcom,qrd";
	qcom,msm-id = <618 0x10000>, <618 0x20000>, <639 0x10000>, <639 0x20000>,
			<0x100026a 0x10000>, <0x100026a 0x20000>,
			<0x100027f 0x10000>, <0x100027f 0x20000>;
	qcom,board-id = <0x43 0xA000>;
};
