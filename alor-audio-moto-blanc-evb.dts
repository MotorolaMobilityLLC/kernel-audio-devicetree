//
/* Copyright (c) 2025 Motorola Mobility LLC. All rights reserved.
 * SPDX-License-Identifier: BSD-3-Clause
 */

/dts-v1/;
/plugin/;

#include "alor-audio-moto-blanc-common.dtsi"
 / {
	model = "blanc";
	compatible = "qcom,alor-qrd", "qcom,alor", "qcom,qrd";
	qcom,msm-id = <685 0x10000>;
	qcom,board-id = <0x41 0x9100>, <0x41 0xB1B0>;
};
