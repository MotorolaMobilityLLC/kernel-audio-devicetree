#include "volcano-audio-mtp.dtsi"
#include "volcano-audio-bt-swr.dtsi"

&pineapple_snd {
	qcom,model = "volcano6i-mtp-wsa883x-snd-card";
	qcom,msm-mbhc-usbc-audio-supported = <1>;
	qcom,msm-mbhc-hphl-swh = <0>;
	qcom,msm-mbhc-gnd-swh = <0>;
	fsa4480-i2c-handle = <&fsa4480>;
	/delete-property/ qcom,pri-mi2s-gpios;
	qcom,wcn-bt = <0>;
	qcom,wcn-btfm-proxy = <1>;
};

&fm_i2s0_gpios {
	status = "disabled";
};
