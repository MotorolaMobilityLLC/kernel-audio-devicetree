/*
   This file is derivated from kalama-audio-mtp.dts
 */

/dts-v1/;
/plugin/;
#define RTWO_RADIO_NA 3
#define RTWO_RADIO_VZM 4
#include "kalama-audio-moto-rtwo-common.dtsi"
 / {
	model = "rtwo";
	compatible = "qcom,kalama-mtp", "qcom,kalama", "qcom,mtp", "mot,rtwo";
	qcom,msm-id = <519 0x10000>, <536 0x10000>, <519 0x20000>, <536 0x20000>;
	qcom,board-id = <0x41 0xB1B0>,  <(RTWO_RADIO_NA << 8 | 0x41) 0xA200>, <(RTWO_RADIO_VZM << 8 | 0x41) 0xA200>;
};

&kalama_snd {
	qcom,model = "kalama-mtp-wsa883x_hdr-snd-card";
	qcom,audio-routing =
		"AMIC1", "Analog Mic1",
		"AMIC1", "MIC BIAS1",
		"AMIC2", "Analog Mic2",
		"AMIC2", "MIC BIAS2",
		"AMIC3", "Analog Mic3",
		"AMIC3", "MIC BIAS4",
		"AMIC4", "Analog Mic4",
		"AMIC4", "MIC BIAS4",
		"AMIC5", "Analog Mic5",
		"AMIC5", "MIC BIAS3",
		"VA AMIC1", "Analog Mic1",
		"VA AMIC1", "VA MIC BIAS1",
		"VA AMIC2", "Analog Mic2",
		"VA AMIC2", "VA MIC BIAS2",
		"VA AMIC3", "Analog Mic3",
		"VA AMIC3", "VA MIC BIAS3",
		"VA AMIC4", "Analog Mic4",
		"VA AMIC4", "VA MIC BIAS4",
		"VA AMIC5", "Analog Mic5",
		"VA AMIC5", "VA MIC BIAS3",
		"IN1_HPHL", "HPHL_OUT",
		"IN2_HPHR", "HPHR_OUT",
		"IN3_AUX", "AUX_OUT",
		"HAP_IN", "PCM_OUT",
		"WSA SRC0_INP", "SRC0",
		"WSA_TX DEC0_INP", "TX DEC0 MUX",
		"WSA_TX DEC1_INP", "TX DEC1 MUX",
		"RX_TX DEC0_INP", "TX DEC0 MUX",
		"RX_TX DEC1_INP", "TX DEC1 MUX",
		"RX_TX DEC2_INP", "TX DEC2 MUX",
		"RX_TX DEC3_INP", "TX DEC3 MUX",
		"SpkrLeft IN", "WSA_SPK1 OUT",
		"SpkrRight IN", "WSA_SPK2 OUT",
		"TX SWR_INPUT", "WCD_TX_OUTPUT",
		"VA SWR_INPUT", "VA_SWR_CLK",
		"VA SWR_INPUT", "WCD_TX_OUTPUT",
		"VA_AIF1 CAP", "VA_SWR_CLK",
		"VA_AIF2 CAP", "VA_SWR_CLK",
		"VA_AIF3 CAP", "VA_SWR_CLK";
};
