/dts-v1/;
/plugin/;

#include "volcano-audio-moto-marvel-common.dtsi"

/ {
	model = "marvel";
	compatible = "qcom,volcano-mtp", "qcom,volcano", "qcom,volcanop-mtp", "qcom,volcanop", "qcom,mtp", "moto,marvel";
	qcom,msm-id = <636 0x10000>, <640 0x10000>, <641 0x10000>, <712 0x10000>;
	qcom,board-id = <0x41 0x9000>;
};
