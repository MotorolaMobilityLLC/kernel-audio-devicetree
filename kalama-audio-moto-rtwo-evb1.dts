/*
   This file is derivated from kalama-audio-mtp.dts
 */

/dts-v1/;
/plugin/;

#include "kalama-audio-moto-rtwo-common.dtsi"
 / {
	model = "rtwo";
	compatible = "qcom,kalama-mtp", "qcom,kalama", "qcom,mtp", "mot,rtwo";
	qcom,msm-id = <519 0x10000>, <536 0x10000>;
	qcom,board-id = <0x10008 0>;
};
